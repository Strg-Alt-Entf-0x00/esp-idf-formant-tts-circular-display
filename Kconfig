## Kconfig
```kconfig
menu "Formant TTS Circular Display"

    config FORMANT_DISPLAY_WIDTH
        int "Display width in pixels"
        default 240
        help
            Width of the circular display (typically 240px for GC9A01)

    config FORMANT_DISPLAY_HEIGHT
        int "Display height in pixels"
        default 240
        help
            Height of the circular display (typically 240px for GC9A01)

    config FORMANT_DISPLAY_ENABLE_TTS_VIZ
        bool "Enable TTS visualization"
        default y
        help
            Enable phoneme display, spectrum analyzer, and IPA/word tracking.

    config FORMANT_DISPLAY_ENABLE_ALPHABET_RING
        bool "Enable alphabet ring"
        default y
        depends on FORMANT_DISPLAY_ENABLE_TTS_VIZ
        help
            Enable the outer A-Z alphabet ring that highlights during speech.

    config FORMANT_DISPLAY_USE_PSRAM
        bool "Use PSRAM for sprite buffer"
        default y
        help
            Store the display sprite buffer in PSRAM instead of internal RAM.
            Recommended for ESP32-P4 with large PSRAM.

    config FORMANT_DISPLAY_SPECTRUM_BARS
        int "Number of spectrum bars"
        default 32
        range 16 64
        depends on FORMANT_DISPLAY_ENABLE_TTS_VIZ
        help
            Number of radial spectrum bars for audio visualization.

    config FORMANT_DISPLAY_IPA_FONT
        bool "Use IPA-capable Unicode font"
        default y
        help
            Enable UTF-8/IPA font support for proper phonetic symbol rendering.
            Uses Noto Sans font (generated by tools/setup_and_generate_fonts.sh
            or tools/generate_fonts_windows.bat).
            Pre-rendered at native sizes (10pt, 12pt, 16pt, ~75KB total in Flash).
            Disable to save flash memory if only ASCII fallback text is needed.

endmenu
```

## examples/full_tts_demo/main/Kconfig.projbuild
```kconfig
menu "Example Display Configuration"

    config EXAMPLE_LCD_SPI_HOST
        int "SPI Host device (1=SPI2_HOST, 2=SPI3_HOST)"
        default 1
        range 1 2
        help
            SPI host peripheral index (1 for SPI2_HOST, 2 for SPI3_HOST).

    config EXAMPLE_LCD_MOSI_GPIO
        int "MOSI GPIO"
        default 28 if IDF_TARGET_ESP32P4
        default 11 if IDF_TARGET_ESP32S3
        default 23
        help
            SPI MOSI pin.

    config EXAMPLE_LCD_SCLK_GPIO
        int "SCLK GPIO"
        default 27 if IDF_TARGET_ESP32P4
        default 12 if IDF_TARGET_ESP32S3
        default 18
        help
            SPI SCLK (Clock) pin.

    config EXAMPLE_LCD_CS_GPIO
        int "CS GPIO"
        default 24 if IDF_TARGET_ESP32P4
        default 10 if IDF_TARGET_ESP32S3
        default 5
        help
            Display Chip Select (CS) pin.

    config EXAMPLE_LCD_DC_GPIO
        int "DC GPIO"
        default 25 if IDF_TARGET_ESP32P4
        default 9 if IDF_TARGET_ESP32S3
        default 2
        help
            Display Data/Command (DC) pin.

    config EXAMPLE_LCD_RST_GPIO
        int "RST GPIO"
        default 26 if IDF_TARGET_ESP32P4
        default 8 if IDF_TARGET_ESP32S3
        default 4
        help
            Display Reset (RST) pin.

    config EXAMPLE_LCD_BL_GPIO
        int "Backlight GPIO (-1 to disable PWM)"
        default -1
        help
            Display backlight pin (PWM controlled via LEDC).
            Set to -1 if backlight is hardwired to 3.3V or not used.

    config EXAMPLE_LCD_SPI_CLOCK_HZ
        int "SPI Pixel Clock (Hz)"
        default 40000000
        range 10000000 80000000
        help
            SPI clock frequency in Hz.
            40 MHz (40000000) is standard for GC9A01.

endmenu
```

## examples/full_tts_demo/sdkconfig.defaults
```kconfig
# ============================================================================
# ESP32-P4 Hardware Target Configuration
# ============================================================================
CONFIG_IDF_TARGET="esp32p4"
CONFIG_ESP32P4_SELECTS_REV_LESS_V3=y

# ============================================================================
# Flash Configuration (32 MB QIO Mode)
# ============================================================================
CONFIG_ESPTOOLPY_FLASHMODE_QIO=y
CONFIG_ESPTOOLPY_FLASHSIZE_32MB=y

# ============================================================================
# PSRAM Configuration (required for TTS + Display)
# ============================================================================
CONFIG_SPIRAM=y
CONFIG_SPIRAM_USE_MALLOC=y

# ============================================================================
# Compiler Optimization
# ============================================================================
CONFIG_COMPILER_OPTIMIZATION_PERF=y
CONFIG_COMPILER_CXX_EXCEPTIONS=y

# ============================================================================
# FreeRTOS Configuration
# ============================================================================
CONFIG_FREERTOS_HZ=1000

# ============================================================================
# Display Component Configuration
# ============================================================================
# Enable TTS visualization
CONFIG_FORMANT_DISPLAY_ENABLE_TTS_VIZ=y

# Enable alphabet ring
CONFIG_FORMANT_DISPLAY_ENABLE_ALPHABET_RING=y

# Use PSRAM for sprite buffer (recommended)
CONFIG_FORMANT_DISPLAY_USE_PSRAM=y

# Display resolution (GC9A01 = 240x240)
CONFIG_FORMANT_DISPLAY_WIDTH=240
CONFIG_FORMANT_DISPLAY_HEIGHT=240

# Spectrum analyzer bars
CONFIG_FORMANT_DISPLAY_SPECTRUM_BARS=32

# Enable IPA fonts for proper phonetic display
CONFIG_FORMANT_DISPLAY_IPA_FONT=y
```

## examples/full_tts_demo/sdkconfig.defaults.esp32s3
```kconfig
# Target configuration for ESP32-S3
CONFIG_IDF_TARGET="esp32s3"

# Flash configuration
CONFIG_ESPTOOLPY_FLASHSIZE_16MB=y

# PSRAM configuration (Octal PSRAM common on S3)
CONFIG_SPIRAM=y
CONFIG_SPIRAM_MODE_OCT=y

# Performance
CONFIG_COMPILER_OPTIMIZATION_PERF=y
CONFIG_COMPILER_CXX_EXCEPTIONS=y
CONFIG_FREERTOS_HZ=1000

# Display Component
CONFIG_FORMANT_DISPLAY_ENABLE_TTS_VIZ=y
CONFIG_FORMANT_DISPLAY_ENABLE_ALPHABET_RING=y
CONFIG_FORMANT_DISPLAY_USE_PSRAM=y
CONFIG_FORMANT_DISPLAY_WIDTH=240
CONFIG_FORMANT_DISPLAY_HEIGHT=240
CONFIG_FORMANT_DISPLAY_SPECTRUM_BARS=32
CONFIG_FORMANT_DISPLAY_IPA_FONT=y
```
